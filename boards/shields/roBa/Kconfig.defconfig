## boards/shields/roBa/Kconfig.defconfig
```kconfig
#ZMKファームウェアにおける左右それぞれのキーボード基板の「初期設定」を定義している場所です。

#右手側　ここのIfの部分がKconfig.shieldのconfigと対応しているので大文字小文字にそろえる
if SHIELD_ROBA_R
#ビルドした時のキーボードの名前を↓の名前に設定
config ZMK_KEYBOARD_NAME
    default "roBa_R"
#分割キーボードであることを定義
config ZMK_SPLIT
    default y
#セントラル側（親機）の定義
config ZMK_SPLIT_ROLE_CENTRAL
    default y

endif

#左手側の設定（右側とほぼ同じ）
if SHIELD_ROBA_L

config ZMK_KEYBOARD_NAME
    default "roBa_L"

config ZMK_SPLIT
    default y

endif
```

## boards/shields/roBa/Kconfig.shield
```kconfig
#Kconfig.defconfig が動くためのスイッチを作成している場所
config SHIELD_ROBA_R
    def_bool $(shields_list_contains,roBa_R)
#ビルドしようとしているリストの中に roBa_R という文字が含まれていたら…
#結果 このフラグを True (ON) にしなさいというような文章


config SHIELD_ROBA_L
    def_bool $(shields_list_contains,roBa_L)
```

## config/west.yml
```yaml
#ファームウェア作成のための材料調達リスト

manifest:#下の本家のzmkとトラックボールのドライバをどこから持ってくるのかを指定しているkumamuk-gitはトラックボール部分の持ってくるとこと推測しているあってるか不明
  remotes:
    - name: zmkfirmware
      url-base: https://github.com/zmkfirmware
    - name: kumamuk-git
      url-base: https://github.com/kumamuk-git
      
  projects:　#本家のzmkファームウェアを持ってくるようにバージョンは安定している０。３を持ってくるように
    - name: zmk
      remote: zmkfirmware
      revision: v0.3-branch
      import: app/west.yml

      #トラックボール用のドライバを持ってくるという意味
    - name: zmk-pmw3610-driver
      remote: kumamuk-git
      revision: main

      #このファイルwest.ymlの立ち位置を決める文章config部分に入れてねという文章これがないとzmkがこのファイルがどこにあるのか見つけられなくなる（じゃあ全てにこういうの必要じゃないかと思った）
  self:
    path: config
```
